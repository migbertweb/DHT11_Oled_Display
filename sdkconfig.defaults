## sdkconfig.defaults
```kconfig
# Optimizaciones generales
CONFIG_COMPILER_OPTIMIZATION_SIZE=y
CONFIG_COMPILER_OPTIMIZATION_ASSERTIONS_DISABLE=y
CONFIG_COMPILER_OPTIMIZATION_ASSERTION_LEVEL=0

# Reducir nivel de logs
CONFIG_LOG_DEFAULT_LEVEL_WARN=y
CONFIG_LOG_DEFAULT_LEVEL=3

# Optimizar FreeRTOS
CONFIG_FREERTOS_HZ=100
CONFIG_FREERTOS_MAX_TASK_NAME_LEN=12
CONFIG_FREERTOS_IDLE_TASK_STACKSIZE=1024

# Configuración WiFi (modo estación)
CONFIG_HTTPD_WS_SUPPORT=y
CONFIG_ESP_WIFI_STA_TASK_STACK_SIZE=2048
CONFIG_ESP_WIFI_SOFTAP_SUPPORT=n
CONFIG_ESP32_WIFI_AMPDU_TX_ENABLED=n
CONFIG_ESP32_WIFI_AMPDU_RX_ENABLED=n
CONFIG_ESP32_WIFI_TX_BA_WIN=1
CONFIG_ESP32_WIFI_RX_BA_WIN=1

# Configuración MQTT
CONFIG_MQTT_BUFFER_SIZE=1024
CONFIG_MQTT_TX_BUFFER=1024
CONFIG_MQTT_OUTBOX_EXPIRED_TIMEOUT_MS=30000
CONFIG_MQTT_TRANSPORT_SSL=n

# Configuración WebSocket
CONFIG_HTTPD_WS_SUPPORT=y
CONFIG_HTTPD_MAX_WS_OPEN_REQS=3

# Optimizar pila TCP/IP
CONFIG_LWIP_TCP_WND_DEFAULT=2048
CONFIG_LWIP_TCP_SND_BUF_DEFAULT=2048
CONFIG_LWIP_TCP_RECVMBOX_SIZE=4

# Deshabilitar características no utilizadas
CONFIG_BT_ENABLED=n
CONFIG_ESP32_SPIRAM_SUPPORT=n
```
